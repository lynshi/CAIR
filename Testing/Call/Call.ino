// FONA Incoming Call Number Example
// Listens for a call and displays the phone number of the caller (if available).
// Use this example to add phone call detection to your own FONA sketch.
#include <Adafruit_FONA.h>
#include <PCM.h>

// Pins which are connected to the FONA.
// Note that this is different from FONAtest!
#define FONA_RX            3
#define FONA_TX            4
#define FONA_RST           5

// Note you need to map interrupt number to pin number
// for your board.  On an Uno & Mega interrupt 0 is
// digital pin 2, and on a Leonardo interrupt 0 is
// digital pin 3.  See this page for a complete table:
//   http://arduino.cc/en/Reference/attachInterrupt
// Make sure this interrupt pin is connected to FONA RI!
#define FONA_RI_INTERRUPT  0

// We default to using software serial. If you want to use hardware serial
// (because softserial isnt supported) comment out the following three lines 
// and uncomment the HardwareSerial line
#include <SoftwareSerial.h>

SoftwareSerial fonaSS = SoftwareSerial(FONA_TX, FONA_RX);
SoftwareSerial *fonaSerial = &fonaSS;


// Hardware serial is also possible!
//  HardwareSerial *fonaSerial = &Serial1;
// this is a large buffer for replies
char replybuffer[255];
Adafruit_FONA fona = Adafruit_FONA(FONA_RST);
char number[30] = {'9','1','7','3','1','8','6','2','5','0'};
const unsigned char zero[] PROGMEM = {
 126, 127, 127, 128, 128, 128, 128, 127, 127, 128, 127, 126,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 128, 
};
const unsigned char one[] PROGMEM = {
 126, 126, 126, 126, 126, 127, 127, 127, 128, 128, 129, 129,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 128, 
};
const unsigned char two[] PROGMEM = {
 124, 126, 130, 129, 128, 130, 128, 127, 128, 126, 127, 127,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 128, 
};
const unsigned char three[] PROGMEM = {
 126, 128, 128, 127, 128, 129, 128, 127, 127, 127, 128, 128,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 128, 
};
//const unsigned char four[] PROGMEM = {
// 126, 126, 127, 128, 128, 128, 128, 127, 127, 128, 129, 128, 127,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 128, 
//};


void setup() {
  Serial.begin(115200);
  Serial.println(F("Initializing....(May take 3 seconds)"));

  fonaSerial->begin(4800);
  if (! fona.begin(*fonaSerial)) {
    Serial.println(F("Couldn't find FONA"));
    while(1);
  }
  Serial.println(F("FONA is OK"));

//  // Enable incoming call notification.
//  if(fona.callerIdNotification(true, FONA_RI_INTERRUPT)) {
//    Serial.println(F("Caller id notification enabled."));
//  }
//  else {
//    Serial.println(F("Caller id notification disabled"));
//  }
}

void loop(){
   while (! Serial.available() ) {
    if (fona.available()) {
      Serial.write(fona.read());
    }
  }

  char command = Serial.read();
  if(command == 'c')
  {
    flushSerial();
    Serial.println();
    
    Serial.print(F("Calling ")); Serial.println(number);
    if (!fona.callPhone(number)) {
      Serial.println(F("Failed"));
    } 
    else {
     Serial.println(F("Sent!")); 
    }
    delay(10000);
    while(fona.getCallStatus() != 4)
    {
      Serial.print(F("."));
      delay(500);
    }
    delay(10000);
    startPlayback(zero, sizeof(zero));
    delay(1000);
    stopPlayback();
    
    delay(1000);
    startPlayback(one, sizeof(one));
    delay(1000);
    stopPlayback();
    
    delay(1000);
    startPlayback(two, sizeof(two));
    delay(1000);
    stopPlayback();
    
    delay(1000);
    startPlayback(three, sizeof(three));
    delay(1000);
    stopPlayback();   
    
    delay(1000);
//    startPlayback(four, sizeof(four));
//    delay(1000);
//    stopPlayback();
//    
//    delay(1000);
    delay(5000);
    fona.hangUp();
  }
    while (! Serial.available() ) {
    if (fona.available()) {
      Serial.write(fona.read());
    }
  }
}

void flushSerial() {
  while (Serial.available())
    Serial.read();
}
